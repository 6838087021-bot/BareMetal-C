#include <stdint.h>
#include <stdbool.h>
#include "baremetal_binary.h"

// VIEW
#define MOLE_LIGHT ((volatile bool     * const)0xE000U)
#define HIT_COUNT  ((volatile uint8_t  * const)0xE803U)
#define MISS_COUNT ((volatile uint8_t  * const)0xE802U)
#define SCORE      ((volatile uint16_t * const)0xE800U)
#define TIMER      ((volatile uint8_t  * const)0xE808U)

// NMI handler monitor
#define BUSY_LED ((volatile bool *)0xE008U)

// CONTROLLER
#define KEYPAD ((volatile const uint8_t * const)0xD011U)

// UART debug output
#define UART ((volatile uint8_t *)0xE040U)

// MODEL helper -- create random
uint8_t random_8bit(uint8_t seed){
    static const uint8_t seq8[256] = {
        0x63, 0x7C, 0x77, 0x7B, 0xF2, 0x6B, 0x6F, 0xC5, 0x30, 0x01, 0x67, 0x2B, 0xFE, 0xD7, 0xAB, 0x76,
        0xCA, 0x82, 0xC9, 0x7D, 0xFA, 0x59, 0x47, 0xF0, 0xAD, 0xD4, 0xA2, 0xAF, 0x9C, 0xA4, 0x72, 0xC0,
        0xB7, 0xFD, 0x93, 0x26, 0x36, 0x3F, 0xF7, 0xCC, 0x34, 0xA5, 0xE5, 0xF1, 0x71, 0xD8, 0x31, 0x15,
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        0x8C, 0xA1, 0x89, 0x0D, 0xBF, 0xE6, 0x42, 0x68, 0x41, 0x99, 0x2D, 0x0F, 0xB0, 0x54, 0xBB, 0x16
    };
    static uint8_t counter = 7;
    counter = counter + seed + 1;
    return seq8[counter];
}

uint8_t random_2bit(uint8_t seed){
    static const uint8_t seq2[256] = {
        0x3, 0x2, 0x1, 0x1, 0x0, 0x1, 0x3, 0x3, 0x2, 0x3, 0x0, 0x0, 0x2, 0x2, 0x0, 0x1,
        0x1, 0x2, 0x3, 0x3, 0x0, 0x3, 0x0, 0x2, 0x0, 0x1, 0x0, 0x2, 0x1, 0x2, 0x1, 0x3,
        0x2, 0x0, 0x1, 0x0, 0x3, 0x3, 0x1, 0x2, 0x3, 0x2, 0x0, 0x2, 0x3, 0x0, 0x1, 0x1,
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        0x0, 0x3, 0x2, 0x3, 0x1, 0x2, 0x0, 0x0, 0x3, 0x3, 0x2, 0x0, 0x1, 0x1, 0x1, 0x2
    };
    static uint8_t counter = 7;
    counter = counter + seed + 1;
    return seq2[counter];
}

// MODEL constants
#define MAX_TIMER (28)
#define MISS_PENALTY (5)
#define MAX_SCORE (299)     // SCORE saturation
#define MAX_HIT_COUNT (99)  // HIT_COUNT saturation
#define MAX_MISS_COUNT (99) // MISS_COUNT saturation

// MODEL-CONTROLLER message
typedef enum {
    WHACK0 = 0,
    WHACK1 = 1,
    WHACK2 = 2,
    WHACK3 = 3,
    NONE = 4
} command;

typedef struct {
    uint8_t mole_position;
    uint8_t timer;
    uint8_t hit_count;
    uint8_t miss_count;
    uint16_t score;
    uint8_t random;
} model_t;

void model_init(model_t *mp){
    mp->random = random_8bit(123);
    mp->mole_position = random_2bit(mp->random);
    // fill in code here
}

void model_update(model_t *mp, command c){
    switch (c) {
        // fill in code here
    }
}

// VIEW helper table
uint8_t bcd_uint8(uint8_t num) {
    static const uint8_t out[256] = {
        0x00, 0x01, 0x02, 0x03, 0x04, 0x05, 0x06, 0x07, 0x08, 0x09, 0x10, 0x11, 0x12, 0x13, 0x14, 0x15,
        0x16, 0x17, 0x18, 0x19, 0x20, 0x21, 0x22, 0x23, 0x24, 0x25, 0x26, 0x27, 0x28, 0x29, 0x30, 0x31,
        0x32, 0x33, 0x34, 0x35, 0x36, 0x37, 0x38, 0x39, 0x40, 0x41, 0x42, 0x43, 0x44, 0x45, 0x46, 0x47,
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        0xEE, 0xEE, 0xEE, 0xEE, 0xEE, 0xEE, 0xEE, 0xEE, 0xEE, 0xEE, 0xEE, 0xEE, 0xEE, 0xEE, 0xEE, 0xEE
    };
    return out[num];
}

uint16_t bcd_uint16(uint16_t num) {
    if (num > MAX_SCORE) {
        return 0xEEEE;
    }

    static uint8_t hundreds;
    hundreds = 0;
    while (num >= 100) {
        num = num - 100;
        hundreds = hundreds + 1;
    }

    return ((uint16_t)hundreds << 8) | bcd_uint8((uint8_t)num);
}

// VIEW
void view_update(model_t *mp){
    // these initial values forces view update. why?
    static uint8_t previous_mole_position = 5; // can be dangerous here! can you explain why?
    static uint8_t previous_miss_count = MAX_MISS_COUNT + 1;
    static uint8_t previous_hit_count  = MAX_HIT_COUNT + 1; 
    static uint16_t previous_score = MAX_SCORE + 1;
    static uint8_t previous_timer = MAX_TIMER + 1;

    // update mole_position
    if (previous_mole_position != mp->mole_position) {
        *(MOLE_LIGHT + previous_mole_position) = false; 
        *(MOLE_LIGHT + mp->mole_position) = true;
    }
    // update miss_count
    if (previous_miss_count != mp->miss_count) {
        *MISS_COUNT = bcd_uint8(mp->miss_count);
    }
    // update hit_count
    if (previous_hit_count != mp->hit_count) {
        *HIT_COUNT = bcd_uint8(mp->hit_count);
    }
    // update timer
    if (previous_timer != mp->timer) {
        *TIMER = bcd_uint8(mp->timer);
    }
    // update score
    if (previous_score != mp->score) {
        *SCORE = bcd_uint16(mp->score);
    }
    // save
    previous_mole_position = mp->mole_position;
    previous_miss_count = mp->miss_count;
    previous_hit_count = mp->hit_count;
    previous_timer = mp->timer;
    previous_score = mp->score;
}

// CONTROLLER
command controller_read(void){
    // fill in code here
}

void nmi_handler(void) __critical __interrupt {
    // we declare them all as static to avoid stack allocation
    static bool busy = false;
    static bool initialized = false;
    static model_t m;
    static model_t *mp = &m;
    static command c;

    if (busy) {
        return; // we cannot afford to do a second interrupt
    }

    busy = true;
    *BUSY_LED = true;
    if (!initialized) {
        model_init(mp);
        initialized = true;
        busy = false;
        *BUSY_LED = false;
        return;
    }
    // CONTROLLER read and MODEL update
    c = controller_read();
    model_update(mp, c);
    view_update(mp);
    busy = false;
    *BUSY_LED = false;
    return;
}

void main(void){
    while (true) {
    }
}
